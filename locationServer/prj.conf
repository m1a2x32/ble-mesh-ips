## CMakeLists.txt
```
# SPDX-License-Identifier: Apache-2.0

cmake_minimum_required(VERSION 3.20.0)
set(BOARD_FLASH_RUNNER jlink)

find_package(Zephyr REQUIRED HINTS $ENV{ZEPHYR_BASE})
project(hello_world)

target_sources(app PRIVATE 
        src/main.c
        src/mesh/prov_conf.c
        src/mesh/model_manager.c
        src/mesh/persistant_store_manager.c)

target_include_directories(app PRIVATE include)
```

## prj.conf
```kconfig
CONFIG_MAIN_STACK_SIZE=4096
CONFIG_SYS_CLOCK_TICKS_PER_SEC=100
CONFIG_SYSTEM_WORKQUEUE_STACK_SIZE=4096
CONFIG_GPIO=y

#XIAO DEPENDENCIES
CONFIG_USB_DEVICE_STACK=y
CONFIG_USB_CDC_ACM=y
CONFIG_BT_SETTINGS=y
CONFIG_FLASH=y
CONFIG_FLASH_PAGE_LAYOUT=y
CONFIG_FLASH_MAP=y
CONFIG_FCB=y
CONFIG_SETTINGS=y
CONFIG_SETTINGS_FCB=y

CONFIG_BT=y
CONFIG_BT_TINYCRYPT_ECC=y
CONFIG_BT_RX_STACK_SIZE=4096

CONFIG_BT_CTLR_DUP_FILTER_LEN=0
CONFIG_BT_OBSERVER=y
CONFIG_BT_BROADCASTER=y

CONFIG_BT_CTLR_LE_ENC=n
CONFIG_BT_CTLR_LE_PING=n
CONFIG_BT_DATA_LEN_UPDATE=n
CONFIG_BT_PHY_UPDATE=n
CONFIG_BT_CTLR_MIN_USED_CHAN=n
CONFIG_BT_CTLR_ADV_EXT=y
CONFIG_BT_CTLR_PRIVACY=n

CONFIG_BT_MESH=y
CONFIG_BT_PERIPHERAL=y
CONFIG_BT_MESH_PB_GATT=y
CONFIG_BT_MESH_PB_ADV=y
CONFIG_BT_DEVICE_NAME="Beacon"

CONFIG_BT_MESH_RELAY=n
CONFIG_BT_MESH_FRIEND=y
CONFIG_BT_MESH_GATT_PROXY=y
CONFIG_BT_MESH_BEACON_ENABLED=n
CONFIG_BT_MESH_ADV_STACK_SIZE=4096

#MODELS
CONFIG_BT_MESH_LOC_SRV=y

CONFIG_BT_MESH_SUBNET_COUNT=1
CONFIG_BT_MESH_APP_KEY_COUNT=1
CONFIG_BT_MESH_MODEL_KEY_COUNT=1
CONFIG_BT_MESH_MODEL_GROUP_COUNT=1
CONFIG_BT_MESH_LABEL_COUNT=0

CONFIG_BT_DEBUG_LOG=n
CONFIG_BT_MESH_DEBUG=n
CONFIG_BT_MESH_DEBUG_NET=n
#CONFIG_BT_MESH_DEBUG_TRANS=y
CONFIG_BT_MESH_DEBUG_SETTINGS=n
CONFIG_BT_MESH_DEBUG_PROV=n
#CONFIG_BT_MESH_DEBUG_BEACON=y
#CONFIG_BT_MESH_DEBUG_CRYPTO=y
CONFIG_BT_MESH_DEBUG_ADV=n
CONFIG_BT_MESH_DEBUG_ACCESS=n

CONFIG_BT_CTLR_ADV_PERIODIC=y

CONFIG_NVS=y
#CONFIG_BT_MESH_DEBUG_PROXY=y

CONFIG_BT_MESH_DEBUG_PROVISIONER=n
CONFIG_BT_MESH_DEBUG_PROV_DEVICE=n
CONFIG_BT_SHELL=n
CONFIG_BT_MESH_PROVISIONER=n
CONFIG_UART_CONSOLE=y
CONFIG_UART_NRFX=n
```

## src/main.c
```c
/*
 * Copyright (c) 2012-2014 Wind River Systems, Inc.
 *
 * SPDX-License-Identifier: Apache-2.0
 */

#include <zephyr/zephyr.h>
#include <bluetooth/bluetooth.h>
#include <bluetooth/mesh/models.h>
#include <prov_conf.h>
#include <model_manager.h>
#include <persistant_store_manager.h>
#include <errno.h>

static void bt_ready()
{
	int err = bt_mesh_init(prov_init(), model_handler_init());
	if (err)
	{
		printk("bt_mesh_init failed with err %d", err);
		return;
	}
	if (IS_ENABLED(CONFIG_SETTINGS)) {
		settings_load();
	}
	// bt_mesh_reset();
    if (!bt_mesh_is_provisioned()) {
    	printk("Node has not been provisioned - beaconing\n");
		bt_mesh_prov_enable(BT_MESH_PROV_ADV | BT_MESH_PROV_GATT);
	} else {
    	printk("Node has already been provisioned\n");
	}
}

void main(void)
{
	settings_subsys_init();
	settings_register(&pos_conf);
	bt_enable(NULL);
	bt_ready();
}
```

## include/model_manager.h
```c
#ifndef BT_MESH_MODEL_MANEGER__
#define BT_MESH_MODEL_MANEGER__

#include <zephyr/bluetooth/mesh.h>

#define STORAGE_NODE_LABEL storage

extern struct bt_mesh_loc_srv locSrv;
const struct bt_mesh_comp *model_handler_init(void);


#endif /* BT_MESH_MODEL_MANEGER__ */
```

## include/persistant_store_manager.h
```c
#ifndef PERSISTANT_STORAGE_MANAGER__
#define PERSISTANT_STORAGE_MANAGER__

#include <zephyr/settings/settings.h>
#include <bluetooth/mesh/models.h>

extern struct settings_handler pos_conf;

#endif
```

## include/prov_conf.h
```c
#ifndef BT_MESH_LIB__
#define BT_MESH_LIB__

#include <zephyr/bluetooth/mesh.h>

const struct bt_mesh_prov *prov_init(void);

#endif /* BT_MESH_LIB__ */
```
