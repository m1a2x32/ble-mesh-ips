## CMakeLists.txt
```
# SPDX-License-Identifier: Apache-2.0

cmake_minimum_required(VERSION 3.20.0)

find_package(Zephyr REQUIRED HINTS $ENV{ZEPHYR_BASE})
project(hello_world)

target_sources(app PRIVATE 
        src/main.c
        src/bt_mesh.c
        src/model_manager.c
        src/localization.c)

target_include_directories(app PRIVATE include)
```

## prj.conf
```kconfig
CONFIG_MAIN_STACK_SIZE=4096
CONFIG_SYS_CLOCK_TICKS_PER_SEC=250
CONFIG_SYSTEM_WORKQUEUE_STACK_SIZE=4096
CONFIG_GPIO=y

#XIAO DEPENDENCIES
CONFIG_USB_DEVICE_STACK=y
CONFIG_USB_CDC_ACM=y
CONFIG_BT_SETTINGS=y
CONFIG_FLASH=y
CONFIG_FLASH_PAGE_LAYOUT=y
CONFIG_FLASH_MAP=y
CONFIG_FCB=y
CONFIG_SETTINGS=y
CONFIG_SETTINGS_FCB=y

CONFIG_BT=y
CONFIG_BT_TINYCRYPT_ECC=y
CONFIG_BT_RX_STACK_SIZE=4096

CONFIG_BT_CTLR_DUP_FILTER_LEN=0
CONFIG_BT_OBSERVER=y
CONFIG_BT_BROADCASTER=y

CONFIG_BT_CTLR_LE_ENC=n
CONFIG_BT_CTLR_LE_PING=n
CONFIG_BT_DATA_LEN_UPDATE=n
CONFIG_BT_PHY_UPDATE=n
CONFIG_BT_CTLR_CHAN_SEL_2=n
CONFIG_BT_CTLR_MIN_USED_CHAN=n
CONFIG_BT_CTLR_ADV_EXT=n
CONFIG_BT_CTLR_PRIVACY=n

CONFIG_BT_MESH=y
CONFIG_BT_PERIPHERAL=y
CONFIG_BT_MESH_PB_GATT=y
CONFIG_BT_MESH_PB_ADV=y
CONFIG_BT_DEVICE_NAME="Tag"

CONFIG_BT_MESH_RELAY=n
CONFIG_BT_MESH_FRIEND=y
CONFIG_BT_MESH_GATT_PROXY=y
CONFIG_BT_MESH_BEACON_ENABLED=n
CONFIG_BT_MESH_ADV_STACK_SIZE=4096

#MODELS
CONFIG_BT_MESH_LOC_CLI=y
CONFIG_BT_MESH_LOC_SRV=y
CONFIG_BT_MESH_SUBNET_COUNT=1
CONFIG_BT_MESH_APP_KEY_COUNT=1
CONFIG_BT_MESH_MODEL_GROUP_COUNT=1
CONFIG_BT_MESH_LABEL_COUNT=0
CONFIG_BT_MESH_CFG_CLI=y

CONFIG_BT_DEBUG_LOG=n
CONFIG_BT_MESH_DEBUG=n
CONFIG_BT_MESH_DEBUG_NET=n
#CONFIG_BT_MESH_DEBUG_TRANS=y
CONFIG_BT_MESH_DEBUG_SETTINGS=n
CONFIG_BT_MESH_DEBUG_PROV=n
#CONFIG_BT_MESH_DEBUG_BEACON=y
#CONFIG_BT_MESH_DEBUG_CRYPTO=y
CONFIG_BT_MESH_DEBUG_ADV=n
CONFIG_BT_MESH_DEBUG_ACCESS=n

CONFIG_NEWLIB_LIBC=y
CONFIG_NEWLIB_LIBC_MIN_REQUIRED_HEAP_SIZE=2048
CONFIG_NEWLIB_LIBC_FLOAT_PRINTF=y

CONFIG_UART_NRFX=n
```

## src/main.c
```c
/*
 * Copyright (c) 2012-2014 Wind River Systems, Inc.
 *
 * SPDX-License-Identifier: Apache-2.0
 */

#include <zephyr/zephyr.h>
#include <bluetooth/bluetooth.h>
#include <bluetooth/mesh/models.h>
#include "bt_mesh.h"
#include "model_manager.h"
#include <errno.h>


static void bt_ready(int err)
{
	if (err)
	{
		printk("bt_enable init failed with err %d", err);
		return;
	}
    printk("Bluetooth initialised OK\n");

	err = bt_mesh_init(prov_init(), model_handler_init());

	if (err)
	{
		printk("bt_mesh_init failed with err %d", err);
		return;
	}
	
	if (IS_ENABLED(CONFIG_SETTINGS)) {
		settings_load();
	}
	// bt_mesh_reset();
    if (!bt_mesh_is_provisioned()) {
    	printk("Node has not been provisioned - beaconing\n");
		bt_mesh_prov_enable(BT_MESH_PROV_ADV | BT_MESH_PROV_GATT);
	} else {
    	printk("Node has already been provisioned\n");
	}
}

void main(void)
{
	int err = bt_enable(bt_ready);
	if (err)
	{
		printk("bt_enable failed with err %d", err);
	}
}
```

## include/localization.h
```c
#ifndef LOCALIZATION_H
#define LOCALIZATION_H

#include <bluetooth/mesh/models.h>

typedef struct {
    uint16_t uuid;
    //struct bt_mesh_loc_global pos;
    struct bt_mesh_loc_local pos;
    int8_t rssi;
} beacon;


double calcDistance(int8_t correctedRssi);
void trilateratePos(struct bt_mesh_loc_local *loc, beacon *a, beacon *b, beacon *c);



#endif
```

## include/model_manager.h
```c
#ifndef BT_MESH_MODEL_MANEGER__
#define BT_MESH_MODEL_MANEGER__

#include <zephyr/bluetooth/mesh.h>
#include <localization.h>

//make beacon linked list + watch dog 
extern beacon bcns[];

const struct bt_mesh_comp *model_handler_init(void);
extern void gen_loc_set_local(struct bt_mesh_loc_srv *srv, struct bt_mesh_msg_ctx *ctx, struct bt_mesh_loc_local *loc);
extern void gen_loc_get_global(struct bt_mesh_loc_srv *srv, struct bt_mesh_msg_ctx *ctx, struct bt_mesh_loc_global *rsp);
extern void gen_loc_set_global(struct bt_mesh_loc_srv *srv, struct bt_mesh_msg_ctx *ctx, struct bt_mesh_loc_global *loc);
extern void gen_loc_get_local(struct bt_mesh_loc_srv *srv, struct bt_mesh_msg_ctx *ctx, struct bt_mesh_loc_local *rsp);

extern void gen_loc_status_local(struct bt_mesh_loc_cli *cli, struct bt_mesh_msg_ctx *ctx, const struct bt_mesh_loc_local *status);
extern void gen_loc_status_global(struct bt_mesh_loc_cli *cli, struct bt_mesh_msg_ctx *ctx, const struct bt_mesh_loc_global *status);

#endif /* BT_MESH_MODEL_MANEGER__ */
```

## src/bt_mesh.c
```c
#include "../include/bt_mesh.h"
#include <zephyr/bluetooth/crypto.h>

static uint8_t dev_uuid[16];

static int provisioning_output_pin(bt_mesh_output_action_t action, uint32_t number)
{
	printk("OOB Number: %u\n", number);
	return 0;
} 

static void provisioning_complete(uint16_t net_idx, uint16_t addr) {
    printk("Provisioning completed\n");
}

static void provisioning_reset(void)
{
	bt_mesh_prov_enable(BT_MESH_PROV_ADV | BT_MESH_PROV_GATT);
}

static const struct bt_mesh_prov prov = {
	.uuid = dev_uuid,
#if defined(CONFIG_BT_MESH_DK_PROV_OOB_LOG) || defined(CONFIG_BT_MESH_DK_PROV_OOB_BLINK)
	.output_size = 1,
#endif
	.output_actions = (0
#ifdef CONFIG_BT_MESH_DK_PROV_OOB_LOG
		| BT_MESH_DISPLAY_NUMBER
		| BT_MESH_DISPLAY_STRING
#endif
#ifdef CONFIG_BT_MESH_DK_PROV_OOB_BLINK
		| BT_MESH_BLINK
#endif
		),
	.output_number = provisioning_output_pin,
#ifdef CONFIG_BT_MESH_DK_PROV_OOB_BUTTON
	.input_size = 1,
	.input_actions = BT_MESH_PUSH,
#endif
	.complete = provisioning_complete,
	.reset = provisioning_reset,
};

const struct bt_mesh_prov *prov_init(void)
{
    bt_rand(&dev_uuid, sizeof(dev_uuid));
    dev_uuid[14] = 0xB0;
	dev_uuid[15] = 0x00;
    printk("\n%02X%02X%02X%02X-%02X%02X-%02X%02X-%02X%02X-%02X%02X%02X%02X%02X%02X\n\n",
            dev_uuid[15], dev_uuid[14], dev_uuid[13], dev_uuid[12],dev_uuid[11], dev_uuid[10], dev_uuid[9], dev_uuid[8],
            dev_uuid[7], dev_uuid[6], dev_uuid[5], dev_uuid[4],dev_uuid[3], dev_uuid[2], dev_uuid[1], dev_uuid[0]);
	return &prov;
}
```

## src/localization.c
```c
#include "localization.h"
#include <math.h>

#define ENVFACTOR 	4.0

/* 
 * Description:
 *          Calculates distance based on a set of RSSI samples. Function removes outliers since due to RSSI instability.
 * PARAM:
 *          input   correctedRssi     Collected samples of RSSI
 */
double calcDistance(int8_t correctedRssi)
{
    double exponent = 0, distance = 0;
    
    exponent = (-60 - correctedRssi);
    exponent = exponent / (10*ENVFACTOR);

    distance = pow(10.0, exponent);

    return distance;
}

/* 
 * Description:
 *          Calculates distance based on a set of RSSI samples. \
 * PARAM:  
 *     input  beacon east
 */
void trilateratePos(struct bt_mesh_loc_local *loc, beacon *a, beacon *b, beacon *c)
{
    double distanceA = calcDistance(a->rssi), 
           distanceB = calcDistance(b->rssi), 
           distanceC = calcDistance(c->rssi);

    long double vb = ((pow(a->pos.east,2)-pow(b->pos.east,2)) + (pow(a->pos.north,2)-pow(b->pos.north,2)) + (pow(distanceB,2)-pow(distanceA,2))) / 2;

    long double va = ((pow(c->pos.east,2)-pow(b->pos.east,2)) + (pow(c->pos.north,2)-pow(b->pos.north,2)) + (pow(distanceB,2) - pow(distanceC,2))) / 2;

    loc->north = (vb*(b->pos.east - c->pos.east) - va*(b->pos.east - c->pos.east)) /
                (((a->pos.north - b->pos.north)*(b->pos.east - c->pos.east)) - ((c->pos.north - b->pos.north)*(b->pos.east - c->pos.east)));

    loc->east = (loc->north*(a->pos.north - b->pos.north) - vb) / (b->pos.east - a->pos.east);
}
```

## src/model_manager.c
```c
#include <zephyr/bluetooth/bluetooth.h>
#include <bluetooth/mesh/models.h>
#include "model_manager.h"
#include <stdio.h>

beacon bcns[3];
static int counter = 0;
// Health Server
static void attention_on(struct bt_mesh_model *model)
{
	printk("Health Srv attention on\n");
}

static void attention_off(struct bt_mesh_model *model)
{
	printk("Health Srv attention off\n");
}

static const struct bt_mesh_health_srv_cb health_srv_cb = {
	.attn_on = attention_on,
	.attn_off = attention_off,
};

static struct bt_mesh_health_srv health_srv = {
	.cb = &health_srv_cb,
};

BT_MESH_HEALTH_PUB_DEFINE(health_pub, 0);

static struct bt_mesh_loc_cli_handlers loc_cli_cb = {
	.global_status = gen_loc_status_global,
	.local_status = gen_loc_status_local,
}; 
static struct bt_mesh_loc_cli locCli = BT_MESH_LOC_CLI_INIT(&loc_cli_cb);

static struct bt_mesh_loc_srv_handlers loc_srv_cb = {
	.local_get = gen_loc_get_local,
	.local_set = gen_loc_set_local,
	.global_get = gen_loc_get_global,
	.global_set = gen_loc_set_global
};
static struct bt_mesh_loc_srv locSrv = BT_MESH_LOC_SRV_INIT(&loc_srv_cb);


// Composition
static struct bt_mesh_elem elements[] = {
	BT_MESH_ELEM(0, 
		BT_MESH_MODEL_LIST(
			BT_MESH_MODEL_CFG_SRV,
			BT_MESH_MODEL_HEALTH_SRV(&health_srv, &health_pub),
			BT_MESH_MODEL_LOC_SRV(&locSrv),
			BT_MESH_MODEL_LOC_CLI(&locCli)
		), 
		BT_MESH_MODEL_NONE),
};

// Node
static struct bt_mesh_comp comp = {
		.cid = 0xFFFF, 	// Company ID
		.elem = elements,
		.elem_count = ARRAY_SIZE(elements),
};

const struct bt_mesh_comp *model_handler_init(void)
{
	// comp.pid = 0x00;
    // if(strcmp(pid, "beacon") == 0)
    // {
    //     comp.pid = 0x1;
    // }
    // else if(strcmp(pid, "whiteboard") == 0)
    // {
    //     comp.pid = 0x2;
    // }
	return &comp;
}

// Location Server
//-------------------------------------------------------------------------------------------------------
void gen_loc_get_local(struct bt_mesh_loc_srv *srv, struct bt_mesh_msg_ctx *ctx, struct bt_mesh_loc_local *rsp)
{
	printk("\n[%02x]->[SRV] RSSI:%d X:%d Y:%d\n", 
		ctx->addr, ctx->recv_rssi, rsp->north, rsp->east);
	bt_mesh_loc_cli_local_get(&locCli, NULL, NULL);
}

void gen_loc_set_local(struct bt_mesh_loc_srv *srv, struct bt_mesh_msg_ctx *ctx, struct bt_mesh_loc_local *loc)
{ 

}

void gen_loc_get_global(struct bt_mesh_loc_srv *srv, struct bt_mesh_msg_ctx *ctx, struct bt_mesh_loc_global *rsp)
{
	printf("\n[%02x]->[SRV] RSSI:%d X:%f Y:%f\n", 
		ctx->addr, ctx->recv_rssi, rsp->longitude, rsp->latitude);
	bt_mesh_loc_cli_global_get(&locCli, NULL, NULL);
}

void gen_loc_set_global(struct bt_mesh_loc_srv *srv, struct bt_mesh_msg_ctx *ctx, struct bt_mesh_loc_global *loc)
{

}

// Location Client
// -------------------------------------------------------------------------------------------------------
void gen_loc_status_global(struct bt_mesh_loc_cli *cli, struct bt_mesh_msg_ctx *ctx, const struct bt_mesh_loc_global *status)
{
	// printf("\n[%02x]->[CLI] RSSI:%d X:%f Y:%f\n", 
	// ctx->addr, ctx->recv_rssi, status->longitude, status->latitude);
	// for (int i = 0; i < counter; i++)
	// {
	// 	if (ctx->addr == bcns[i].uuid)
	// 	{
	// 		//empty buffer (restart)
	// 		printk("Node msg repeated/n");
	// 		return;
	// 	}
	// }
	
	
	// bcns[counter].uuid = ctx->addr;
	// bcns[counter].rssi = ctx->recv_rssi;
	// memcpy(&bcns[counter].gPos, status, sizeof( struct bt_mesh_loc_global));
	// counter++;
	
	// if (counter >= 3)
	// {
	// 	counter = 0;
	// 	trilateratePos(&global, &bcns[0], &bcns[1], &bcns[2]);
	// 	if(bt_mesh_loc_srv_global_pub(&locSrv, NULL, &global) == 0)
	// 		printf("\nmy pos (x,y): %f,%f\n", global.longitude, global.latitude);
	//}
}

void gen_loc_status_local(struct bt_mesh_loc_cli *cli, struct bt_mesh_msg_ctx *ctx, const struct bt_mesh_loc_local *status)
{ // store data in ringbuffer, once size becomes three or larger estrimate pos and send 
	printk("\n[%02x]->[CLI] RSSI:%d X:%d Y:%d\n", 
	ctx->addr, ctx->recv_rssi, status->east, status->north);
	for (int i = 0; i < counter; i++)
	{
		if (ctx->addr == bcns[i].uuid)
		{
			//empty buffer (restart)
			printk("Node msg repeated/n");
			return;
		}
	}
	
	
	bcns[counter].uuid = ctx->addr;
	bcns[counter].rssi = ctx->recv_rssi;
	memcpy(&bcns[counter].pos, status, sizeof( struct bt_mesh_loc_local));
	counter++;
	
	if (counter >= 3)
	{
		counter = 0;
		trilateratePos(&local, &bcns[0], &bcns[1], &bcns[2]);
		if(bt_mesh_loc_srv_local_pub(&locSrv, NULL, &local) == 0)
			printk("\nmy pos (x,y): %d,%d\n", local.east, local.north);
	}
}
```
