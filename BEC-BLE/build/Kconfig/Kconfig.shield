## locationClient/build_dk/Kconfig/Kconfig.shield
```kconfig
osource "d:/nrfCode/ibeacon/boards/shields/*/Kconfig.shield"
osource "d:/nrfCode/trackingNode/boards/shields/*/Kconfig.shield"
osource "d:/nrfCode/BLECode/scan_adv/boards/shields/*/Kconfig.shield"
osource "D:/nrfCode/BLECode/nrf/boards/shields/*/Kconfig.shield"
```

## locationServer/build_dk/Kconfig/Kconfig.shield.defconfig
```kconfig
osource "d:/nrfCode/ibeacon/boards/shields/*/Kconfig.defconfig"
osource "d:/nrfCode/trackingNode/boards/shields/*/Kconfig.defconfig"
osource "d:/nrfCode/BLECode/scan_adv/boards/shields/*/Kconfig.defconfig"
osource "D:/nrfCode/BLECode/nrf/boards/shields/*/Kconfig.defconfig"
```

## locationServer/build_xi/Kconfig/Kconfig.modules
```kconfig
menu "nrf (D:/nrfCode/BLECode/nrf)"
osource "D:/nrfCode/BLECode/nrf/Kconfig.nrf"
config ZEPHYR_NRF_MODULE
	bool
	default y
endmenu
menu "hostap (D:/nrfCode/BLECode/modules/lib/hostap)"
osource "D:/nrfCode/BLECode/modules/lib/hostap/zephyr/Kconfig"
config ZEPHYR_HOSTAP_MODULE
	bool
	default y
endmenu
menu "mcuboot (D:/nrfCode/BLECode/bootloader/mcuboot)"
osource "$(ZEPHYR_MCUBOOT_KCONFIG)"
config ZEPHYR_MCUBOOT_MODULE
	bool
	default y
endmenu
menu "mbedtls (D:/nrfCode/BLECode/modules/crypto/mbedtls)"
osource "$(ZEPHYR_MBEDTLS_KCONFIG)"
config ZEPHYR_MBEDTLS_MODULE
	bool
	default y
endmenu
menu "trusted-firmware-m (D:/nrfCode/BLECode/modules/tee/tf-m/trusted-firmware-m)"
osource "$(ZEPHYR_TRUSTED_FIRMWARE_M_KCONFIG)"
config ZEPHYR_TRUSTED_FIRMWARE_M_MODULE
	bool
	default y
endmenu
menu "cjson (D:/nrfCode/BLECode/modules/lib/cjson)"
osource "$(ZEPHYR_CJSON_KCONFIG)"
config ZEPHYR_CJSON_MODULE
	bool
	default y
endmenu
menu "azure-sdk-for-c (D:/nrfCode/BLECode/modules/lib/azure-sdk-for-c)"
osource "$(ZEPHYR_AZURE_SDK_FOR_C_KCONFIG)"
config ZEPHYR_AZURE_SDK_FOR_C_MODULE
	bool
	default y
endmenu
menu "memfault-firmware-sdk (D:/nrfCode/BLECode/modules/lib/memfault-firmware-sdk)"
osource "D:/nrfCode/BLECode/modules/lib/memfault-firmware-sdk/ports/zephyr/Kconfig"
config ZEPHYR_MEMFAULT_FIRMWARE_SDK_MODULE
	bool
	default y
endmenu
menu "cirrus-logic (D:/nrfCode/BLECode/modules/hal/cirrus-logic)"
osource "D:/nrfCode/BLECode/modules/hal/cirrus-logic/Kconfig"
config ZEPHYR_CIRRUS_LOGIC_MODULE
	bool
	default y
endmenu
menu "openthread (D:/nrfCode/BLECode/modules/lib/openthread)"
osource "$(ZEPHYR_OPENTHREAD_KCONFIG)"
config ZEPHYR_OPENTHREAD_MODULE
	bool
	default y
endmenu
menu "canopennode (D:/nrfCode/BLECode/modules/lib/canopennode)"
osource "$(ZEPHYR_CANOPENNODE_KCONFIG)"
config ZEPHYR_CANOPENNODE_MODULE
	bool
	default y
endmenu
menu "chre (D:/nrfCode/BLECode/modules/lib/chre)"
osource "D:/nrfCode/BLECode/modules/lib/chre/platform/zephyr/Kconfig"
config ZEPHYR_CHRE_MODULE
	bool
	default y
endmenu
menu "hal_nordic (D:/nrfCode/BLECode/modules/hal/nordic)"
osource "$(ZEPHYR_HAL_NORDIC_KCONFIG)"
config ZEPHYR_HAL_NORDIC_MODULE
	bool
	default y
endmenu
menu "liblc3codec (D:/nrfCode/BLECode/modules/lib/liblc3codec)"
osource "$(ZEPHYR_LIBLC3CODEC_KCONFIG)"
config ZEPHYR_LIBLC3CODEC_MODULE
	bool
	default y
endmenu
menu "littlefs (D:/nrfCode/BLECode/modules/fs/littlefs)"
osource "$(ZEPHYR_LITTLEFS_KCONFIG)"
config ZEPHYR_LITTLEFS_MODULE
	bool
	default y
endmenu
menu "loramac-node (D:/nrfCode/BLECode/modules/lib/loramac-node)"
osource "$(ZEPHYR_LORAMAC_NODE_KCONFIG)"
config ZEPHYR_LORAMAC_NODE_MODULE
	bool
	default y
endmenu
menu "lvgl (D:/nrfCode/BLECode/modules/lib/gui/lvgl)"
osource "D:/nrfCode/BLECode/modules/lib/gui/lvgl/zephyr/Kconfig"
config ZEPHYR_LVGL_MODULE
	bool
	default y
endmenu
menu "lz4 (D:/nrfCode/BLECode/modules/lib/lz4)"
osource "$(ZEPHYR_LZ4_KCONFIG)"
config ZEPHYR_LZ4_MODULE
	bool
	default y
endmenu
menu "nanopb (D:/nrfCode/BLECode/modules/lib/nanopb)"
osource "$(ZEPHYR_NANOPB_KCONFIG)"
config ZEPHYR_NANOPB_MODULE
	bool
	default y
endmenu
menu "picolibc (D:/nrfCode/BLECode/modules/lib/picolibc)"
osource "D:/nrfCode/BLECode/modules/lib/picolibc/zephyr/Kconfig"
config ZEPHYR_PICOLIBC_MODULE
	bool
	default y
endmenu
menu "TraceRecorder (D:/nrfCode/BLECode/modules/debug/TraceRecorder)"
osource "D:/nrfCode/BLECode/modules/debug/TraceRecorder/kernelports/Zephyr/Kconfig"
config ZEPHYR_TRACERECORDER_MODULE
	bool
	default y
endmenu
menu "zcbor (D:/nrfCode/BLECode/modules/lib/zcbor)"
osource "$(ZEPHYR_ZCBOR_KCONFIG)"
config ZEPHYR_ZCBOR_MODULE
	bool
	default y
endmenu
menu "zscilib (D:/nrfCode/BLECode/modules/lib/zscilib)"
osource "D:/nrfCode/BLECode/modules/lib/zscilib/Kconfig.zscilib"
config ZEPHYR_ZSCILIB_MODULE
	bool
	default y
endmenu
menu "nrfxlib (D:/nrfCode/BLECode/nrfxlib)"
osource "D:/nrfCode/BLECode/nrfxlib/Kconfig.nrfxlib"
config ZEPHYR_NRFXLIB_MODULE
	bool
	default y
endmenu
menu "connectedhomeip (D:/nrfCode/BLECode/modules/lib/matter)"
osource "D:/nrfCode/BLECode/modules/lib/matter/config/nrfconnect/chip-module/Kconfig"
config ZEPHYR_CONNECTEDHOMEIP_MODULE
	bool
	default y
endmenu
```
