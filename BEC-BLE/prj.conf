## CMakeLists.txt
```
# SPDX-License-Identifier: Apache-2.0

cmake_minimum_required(VERSION 3.20.0)

find_package(Zephyr REQUIRED HINTS $ENV{ZEPHYR_BASE})
project(BEC-BLE)

target_sources(app PRIVATE 
                src/main.c
                src/mesh/provisioner.c
                src/mesh/composition.c
                src/mesh/network_controller.c
                src/serial/uart_handler.c)

target_include_directories(app PRIVATE include)
```

## prj.conf
```kconfig
CONFIG_TEST=y
CONFIG_TEST_LOGGING_DEFAULTS=n
CONFIG_MAIN_STACK_SIZE=2048
CONFIG_ISR_STACK_SIZE=1024
CONFIG_SYSTEM_WORKQUEUE_STACK_SIZE=2048



CONFIG_BT=y
CONFIG_BT_OBSERVER=y
CONFIG_BT_PERIPHERAL=y
CONFIG_BT_TINYCRYPT_ECC=y
CONFIG_BT_DEVICE_NAME="BEC"
CONFIG_BT_GATT_CACHING=n

CONFIG_BT_CTLR_DUP_FILTER_LEN=0
CONFIG_BT_CTLR_LE_ENC=n
CONFIG_BT_CTLR_LE_PING=n
CONFIG_BT_DATA_LEN_UPDATE=n
CONFIG_BT_PHY_UPDATE=n
CONFIG_BT_CTLR_CHAN_SEL_2=n
CONFIG_BT_CTLR_MIN_USED_CHAN=n
CONFIG_BT_CTLR_ADV_EXT=n
CONFIG_BT_CTLR_PRIVACY=n
CONFIG_BT_CTLR_DTM_HCI=n
CONFIG_BT_CTLR_EXT_SCAN_FP=n
CONFIG_BT_DATA_LEN_UPDATE=n
CONFIG_BT_CTLR_PER_INIT_FEAT_XCHG=n
CONFIG_BT_LL_SW_SPLIT=y
CONFIG_BT_CTLR_ADVANCED_FEATURES=y
CONFIG_BT_CTLR_FILTER_ACCEPT_LIST=n

CONFIG_BT_L2CAP_TX_BUF_COUNT=4

CONFIG_BT_MESH=y
CONFIG_BT_MESH_RELAY=y
CONFIG_BT_MESH_LOW_POWER=y
CONFIG_BT_MESH_LPN_AUTO=n
CONFIG_BT_MESH_FRIEND=y
CONFIG_BT_MESH_FRIEND_QUEUE_SIZE=16
CONFIG_BT_MESH_CDB=y
CONFIG_BT_MESH_PROVISIONER=y
CONFIG_BT_MESH_ADV_BUF_COUNT=9
CONFIG_BT_MESH_PB_GATT=y
CONFIG_BT_MESH_PB_ADV=y
CONFIG_BT_MESH_GATT_PROXY=y
CONFIG_BT_MESH_NODE_ID_TIMEOUT=10


CONFIG_BT_MESH_TX_SEG_MSG_COUNT=2
CONFIG_BT_MESH_RX_SEG_MSG_COUNT=2

# Mesh models
CONFIG_BT_MESH_CFG_CLI=y
CONFIG_BT_MESH_HEALTH_CLI=y
CONFIG_BT_MESH_LOC_CLI=y

# Network config
CONFIG_BT_MESH_SUBNET_COUNT=2
CONFIG_BT_MESH_APP_KEY_COUNT=2
CONFIG_BT_MESH_MODEL_KEY_COUNT=2
CONFIG_BT_MESH_MODEL_GROUP_COUNT=3
CONFIG_BT_MESH_LABEL_COUNT=1


CONFIG_BT_MESH_IV_UPDATE_TEST=y

##Debug
CONFIG_BT_DEBUG_LOG=y
CONFIG_BT_MESH_DEBUG=n
CONFIG_DEBUG_THREAD_INFO=n
CONFIG_DEBUG_OPTIMIZATIONS=n
CONFIG_BT_MESH_DEBUG_PROV=n
CONFIG_BT_MESH_DEBUG_PROVISIONER=n
CONFIG_BT_MESH_DEBUG_ACCESS=n
CONFIG_BT_MESH_DEBUG_CFG=n

# For handling doubles
CONFIG_NEWLIB_LIBC=y
CONFIG_NEWLIB_LIBC_MIN_REQUIRED_HEAP_SIZE=2048
CONFIG_NEWLIB_LIBC_FLOAT_PRINTF=y
CONFIG_UART_INTERRUPT_DRIVEN=y

# Config mesh settings
CONFIG_BT_SETTINGS=y
CONFIG_FLASH=y
CONFIG_FLASH_PAGE_LAYOUT=y
CONFIG_FLASH_MAP=y
CONFIG_NVS=y
CONFIG_SETTINGS=y
CONFIG_BT_MESH_CDB_NODE_COUNT=15
```

## src/main.c
```c
/*
 * Copyright (c) 2012-2014 Wind River Systems, Inc.
 *
 * SPDX-License-Identifier: Apache-2.0
 */

#include <zephyr/zephyr.h>
#include "BEC_ELement.h"
#include "serial_protocol.h"



static int bt_ready(void)
{
	uint8_t net_key[16], dev_key[16];

	int err = bt_mesh_init(&node_provisioning, &node_composition);
	if (err) {
		printk("Initializing mesh failed (err %d)\n", err);
		return err;
	}
	
	if (IS_ENABLED(CONFIG_BT_SETTINGS)) {// Load mesh settings
		printk("Loading stored settings\n");
		settings_load();
	}
	// bt_mesh_reset();
	// bt_mesh_cdb_clear();

	// Check if loaded cdb
	bt_rand(net_key, 16);
	err = bt_mesh_cdb_create(net_key);
	if (err == -EALREADY) {
		printk("Using stored CDB:\n");
	} else if (err) {
		printk("Failed to create CDB (err %d)\n", err);
		return err;
	} else {
		printk("Created CDB\n");
		setup_cdb();
	}

	// Check for local prov
	bt_rand(dev_key, 16);
	err = bt_mesh_provision(net_key, BT_MESH_NET_PRIMARY, 0, 0, LOCAL,
				dev_key);
	if (err == -EALREADY) {
		printk("Using stored settings\n");
	} else if (err) {
		printk("Provisioning failed (err %d)\n", err);
		return err;
	} else {
		printk("Provisioning completed\n");
	}

	return 0;
}

void main(void)
{
	initUART();

	int err = bt_enable(NULL);
	if (err) {
		printk("Bluetooth init failed (err %d)\n", err);
		return;
	}
	printk("Bluetooth initialized\n");
	bt_ready();
	
	while (1)
	{ // main thread handling semaphores
		if(k_sem_take(&uart_sem, K_MSEC(200)) == 0) {
			parseCommand(rx_buf);
		}

		if (k_sem_take(&mesh_sem, K_SECONDS(1)) == 0)
		{
			configure_node_ips(dst);
			mod_ips_pub_sub(dst);
		}
	}
}
```

## include/BEC_Element.h
```c
#ifndef BEC_AUTOMATED_PROV
#define BEC_AUTOMATED_PROV

#include <bluetooth/mesh/cdb.h>
#include <zephyr/settings/settings.h>
#include <zephyr/bluetooth/bluetooth.h>
#include <bluetooth/mesh/models.h>
#include <zephyr/bluetooth/mesh.h>

#define LOCAL 0x1
#define BEACON_RANGE_START (uint16_t)0xA01
#define BEACON_RANGE_END BEACON_RANGE_START+0xF
#define ASSET_RANGE_START (uint16_t)0xB01
#define ASSET_RANGE_END ASSET_RANGE_START+0xF

#define DEF_ATTENTION_DURATION 1

extern uint16_t locationBuf[];
extern size_t locBufCount;
extern uint16_t dst;
extern struct k_sem mesh_sem;

// for node composition
extern struct bt_mesh_loc_local local_loc;
extern struct bt_mesh_loc_cli locCli;

extern struct bt_mesh_comp node_composition;
extern struct bt_mesh_prov node_provisioning;


enum {
    INDEX0,
    OK,
    NODE_NOT_FOUND,
    NODE_NOT_PROVISIONED,
};

enum {
   TIMEOUT,
   NODEUNPROV,
   NODEPROV
};
// MISSING API FUNCTIONS
// identify



/* Desc:    Adds net key to selected node. Function is redundant as the provisioning process already adds netkey. 
            Could be used in the future when more subnets are implemented. 
   Input:   UUID - unique address
   Output:  Error code  */
extern void configure_node_ips(uint16_t uuid);

/* Desc:    Adds indoor application key to such selected node. 
   Input:   UUID - unique address
   Output:  Error code  */
extern void add_ips_app_key(uint16_t uuid);

/* Desc:    Detects type of node and configures subscription and publication values accordingly. 
   Input:   UUID - unique address
   Output:  Error code  */
extern uint8_t mod_ips_pub_sub(uint16_t uuid);

/* Desc:    Configures location of a specified beacon. 
   Input:   UUID - unique address
            loc  - specified location
   Output:  Error code sn  */
extern void set_location(uint16_t uuid, struct bt_mesh_loc_local loc);

/* Desc:    Gets location of a specified node. Could target beacons, but that location should already be known. 
   Input:   UUID - unique address
   Output:  Error code  */
extern void get_location(uint16_t uuid);

/* Desc:    Removes node from mesh network. 
   Input:   UUID - unique address
   Output:  Error code  */
extern void delete(uint16_t uuid);

/* Desc:    Prints a list of available net/app keys and nodes.   */
extern void print_cdb(void);

extern void setup_cdb(void);



#endif
```

## include/serial_protocol.h
```c
#ifndef BEC_UART_CTRL_PROTOCOL
#define BEC_UART_CTRL_PROTOCOL
#include <zephyr/device.h>
#include <zephyr/drivers/uart.h>

// commands
enum {
    IDLE,
    DELETE_ASSET,
    IDENTIFY_ASSET,
    GET_NODE,
    GET_LOCATION,
    SET_LOCATION
};

// Msg Positon
enum {
    OPCODE,
    UUIDMSB,
    UUIDLSB,
    XPOSMSB,
    XPOSLSB,
    YPOSMSB,
    YPOSLSB,
};

#define UARTMSGSIZE 16
#define STOPCHAR 254
#define STARTCHAR 253

extern uint8_t rx_buf[];
extern struct k_sem uart_sem;
/* Desc:    Initiates UART peripherals and semaphore used for handling. */
void initUART(void);

/* Desc:    Detects command received by uart and reacts accordingly. 
   Input:   rxbuf - buffer when uart data is received
   Output:  Error code  */
int parseCommand(uint8_t *rxbuf);

void send_ack_uart(uint8_t opcode, uint16_t *uuid, size_t bufSize, uint8_t err);

#endif
```
